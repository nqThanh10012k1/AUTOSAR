AUTOSAR XML (schema 00050)
package /Interfaces
  sender receiver interface SRIF_Data: is-service=true
    data Data: category=VALUE, sw-calibration-access=READ-ONLY, type=uint8
