AUTOSAR XML (schema 00049)
package /Company/Powertrain/Interfaces
  sender receiver interface Lookup_Val
    data Lookup: category=VALUE, sw-calibration-access=READ-ONLY, type=uint8
