AUTOSAR XML (schema 00050)
package /Components
  application sw component type NSW
    behavior NSW_IB: handle-termination-and-restart=NO-SUPPORT
      ar-typed-per-instance-memorys:
        data NSW_Nv_Block: category=VALUE, sw-calibration-access=READ-ONLY, type=UInt8
      timing event Event_NSW_Step: start-on-event=NSW_Step, period=0.2
      runnable NSW_Init
      runnable NSW_Step
      swc service dependency SwcNv_NSW_Nv_Block: assigned-datas=role-based-data-assignment={role=ramBlock, used-data-element=NSW_Nv_Block}
        service-needs:
          nv block needs SwcNv_NSW_Nv_Block: restore-at-start=true, store-at-shutdown=true
