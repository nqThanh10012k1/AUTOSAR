AUTOSAR XML (schema 00050)
package /Timing
  vfb timing ModeSwitchComposition_timing: component=ModeSwitchComposition
    timing-requirements:
      execution order constraint EOC: base-composition=ModeSwitchComposition
        ordered-elements:
          eoc executable entity ref SlaveSWC_SlaveSWC_Step: component=SlaveSWC, executable=SlaveSWC_Step, successor=MasterSWC_MasterSWC_Step
          eoc executable entity ref MasterSWC_MasterSWC_Step: component=MasterSWC, executable=MasterSWC_Step
