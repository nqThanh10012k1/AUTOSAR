AUTOSAR XML (schema 00050)
package /Components/SwcImplementations
  swc implementation Sensor_Impl: programming-language=C, sw-version=1.8.1, used-code-generator=Embedded Coder 7.10 (R2023a) 19-Nov-2022, vendor-id=0, behavior=Sensor_IB
    code-descriptors:
      code Code
        artifact-descriptors:
          short-label=Sensor_c, category=SWSRC
          short-label=Sensor_h, category=SWHDR
          short-label=rtwtypes_h, category=SWHDR
    resource consumption RsrcCons_Sensor
