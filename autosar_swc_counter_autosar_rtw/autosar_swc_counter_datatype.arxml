AUTOSAR XML (schema 00049)
standard types defined: uint8
package /Company/Powertrain/DataTypes
  impl type UInt8_my_qualifier_const: category=VALUE, base-type=uint8, range raw 0..255, additional-native-type-qualifier=const my_qualifier
  impl type SUMOUT_LOOKUP: category=STRUCTURE
    element BP1: implementation-data-type=rt_Array_uint8_6
    element Table: implementation-data-type=rt_Array_uint8_6
  impl type rt_Array_uint8_6: category=ARRAY
    element rt_Array_uint8_6: array-size=6, array-size-semantics=FIXED-SIZE, implementation-data-type=uint8
package /Company/Powertrain/DataTypes/ApplDataTypes
  app type Appl_SUMOUT: category=CURVE, sw-calibration-access=READ-WRITE, sw-calprm-axis-set={sw-axis-index=1, category=STD_AXIS, sw-axis-individual={input-variable-type=uint8, compu {identical}, sw-max-axis-points=6, sw-min-axis-points=6, range phys 0..255}}, compu {identical}, range phys 0..255, sw-record-layout=IntCur_u8_u8_M, value-axis-data-type=uint8
  app type uint8: category=VALUE, sw-calibration-access=READ-WRITE, compu {identical}, range phys 0..255
package /Company/Powertrain/DataTypes/ApplDataTypes/SwRecordLayouts
  sw record layout IntCur_u8_u8_M: sw-record-layout-group={short-label=IntCur_u8_u8_M, sw-record-layout-group={short-label=X, category=INDEX_INCR, sw-record-layout-group-axis=1, sw-record-layout-group-index=X, sw-record-layout-group-from=1, sw-record-layout-group-to=-1, sw-record-layout-v={short-label=VALUE, base-type=uint8, sw-record-layout-v-axis=1, sw-record-layout-v-prop=VALUE}}, sw-record-layout-group={short-label=Val, category=COLUMN_DIR, sw-record-layout-group-axis=1, sw-record-layout-group-index=X, sw-record-layout-group-from=1, sw-record-layout-group-to=-1, sw-record-layout-v={short-label=Val, base-type=uint8, sw-record-layout-v-axis=0, sw-record-layout-v-prop=VALUE, sw-record-layout-v-index=X}}}
package /Company/Powertrain/DataTypes/DataTypeMappings
  data type mapping set autosar_swc_counterDataTypeMappingsSet
    data-type-maps:
      application-data-type=uint8, implementation-data-type=uint8
      application-data-type=Appl_SUMOUT, implementation-data-type=SUMOUT_LOOKUP
package /Company/Powertrain/DataTypes/Ground
  4 x constant specification:
    INC: value-spec=INC:1
    LIMIT: value-spec=LIMIT:5
    RESET: value-spec=RESET:0
    SUMOUT: value-spec=[11 12 13 14 15 16] over axis [1 2 3 4 5 6]
package /Company/Powertrain/DataTypes/SwAddrMethods
  sw addr method CODE: memory-allocation-keyword-policy=ADDR-METHOD-SHORT-NAME, section-type=CODE
  sw addr method VAR: memory-allocation-keyword-policy=ADDR-METHOD-SHORT-NAME, section-type=VAR
package /Company/Powertrain/DataTypes/Units
  unit NoUnit: factor-si-to-unit=1, offset-si-to-unit=0
