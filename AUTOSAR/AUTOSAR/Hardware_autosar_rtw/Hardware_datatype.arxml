AUTOSAR XML (schema 00050)
standard types defined: UInt16, Double, uint16, float64
package /DataTypes/SwAddrMethods
  sw addr method CODE: section-type=CODE
  sw addr method CONST: section-type=CONST
  sw addr method VAR: section-type=VAR
