/******************************************************************************
* ASAP2 file: autosar_swc_counter.a2l
* Code generation for model "autosar_swc_counter".
* Model version : 8.1
* Simulink Coder version : 9.9 (R2023a) 19-Nov-2022
* C source code generated on : Fri Mar 28 05:03:46 2025
* Target selection: autosar.tlc
* Embedded hardware selection: Intel->x86-64 (Windows64)
* Code generation objectives: Unspecified
* Validation result: Not run
* (add additional file header information here)
******************************************************************************/ ASAP2_VERSION 1 71
/* Version 1.71 */
/begin PROJECT ProjectName "Project Comment Goes Here"
/begin HEADER "Header Comments go here" /end HEADER
/begin MODULE ModuleName "Module Comment Goes Here"
/begin MOD_PAR "MOD PAR Comment Goes Here" /end MOD_PAR
/begin MOD_COMMON "Mod Common Comment Here" BYTE_ORDER MSB_LAST ALIGNMENT_BYTE 1 ALIGNMENT_WORD 2 ALIGNMENT_LONG 4 ALIGNMENT_FLOAT32_IEEE 4 ALIGNMENT_FLOAT64_IEEE 8 ALIGNMENT_INT64 8 /end MOD_COMMON
/begin CHARACTERISTIC AMP /* Long Identifier */ "" /* Type */ VALUE /* ECU Address */ 0x0000 /* @ECU_Address@AMP@ */ /* Record Layout */ Record_UBYTE /* Maximum Difference */ 0 /* Conversion Method */ autosar_swc_counter_CM_uint8 /* Lower Limit */ 0 /* Upper Limit */ 255 /end CHARACTERISTIC
/begin CHARACTERISTIC INC /* Long Identifier */ "" /* Type */ VALUE /* ECU Address */ 0x0000 /* @ECU_Address@INC@ */ /* Record Layout */ Record_UBYTE /* Maximum Difference */ 0 /* Conversion Method */ autosar_swc_counter_CM_uint8 /* Lower Limit */ 0 /* Upper Limit */ 255 /end CHARACTERISTIC
/begin MEASUREMENT InData "" SLONG autosar_swc_counter_CM_int32 0 0 -2147483648 2147483647 ECU_ADDRESS 0x0000 /* @ECU_Address@InData@ */ /end MEASUREMENT
/begin MEASUREMENT OutData "" SLONG autosar_swc_counter_CM_int32 0 0 -2147483648 2147483647 ECU_ADDRESS 0x0000 /* @ECU_Address@OutData@ */ /end MEASUREMENT
/begin MEASUREMENT autosar_swc_co_UnitDelay_DSTATE "" UBYTE autosar_swc_counter_CM_uint8 0 0 0 255 ECU_ADDRESS 0x0000 /* @ECU_Address@autosar_swc_co_UnitDelay_DSTATE@ */ /end MEASUREMENT
/begin MEASUREMENT autosar_swc_counter_ARID_DEF.Amplifier_Trig_ZCE "" UBYTE autosar_swc_counter_CM_ZCSigState 0 0 0 255 ECU_ADDRESS 0x0000 /* @ECU_Address@autosar_swc_counter_ARID_DEF.Amplifier_Trig_ZCE@ */ /end MEASUREMENT
/begin MEASUREMENT autosar_swc_counter_ARID_DEF.Gain "" SLONG autosar_swc_counter_CM_int32 0 0 -2147483648 2147483647 ECU_ADDRESS 0x0000 /* @ECU_Address@autosar_swc_counter_ARID_DEF.Gain@ */ /end MEASUREMENT
/begin COMPU_METHOD autosar_swc_counter_CM_ZCSigState "Q = V" IDENTICAL "%0.6" "" /end COMPU_METHOD
/begin COMPU_METHOD autosar_swc_counter_CM_int32 "Q = V" IDENTICAL "%10.0" "" /end COMPU_METHOD
/begin COMPU_METHOD autosar_swc_counter_CM_uint8 "Q = V" IDENTICAL "%3.0" "" /end COMPU_METHOD
/begin RECORD_LAYOUT Record_SLONG FNC_VALUES 1 SLONG COLUMN_DIR DIRECT /end RECORD_LAYOUT
/begin RECORD_LAYOUT Record_UBYTE FNC_VALUES 1 UBYTE COLUMN_DIR DIRECT /end RECORD_LAYOUT
/begin GROUP autosar_swc_counter "autosar_swc_counter" /* Root */ ROOT /begin SUB_GROUP autosar_swc_counter_Amplifier /end SUB_GROUP /begin REF_CHARACTERISTIC INC /end REF_CHARACTERISTIC /begin REF_MEASUREMENT InData OutData autosar_swc_co_UnitDelay_DSTATE /end REF_MEASUREMENT /end GROUP
/begin GROUP autosar_swc_counter_Amplifier "autosar_swc_counter/Amplifier" /begin REF_CHARACTERISTIC AMP /end REF_CHARACTERISTIC /begin REF_MEASUREMENT InData autosar_swc_counter_ARID_DEF.Gain /end REF_MEASUREMENT /end GROUP
/end MODULE
/end PROJECT
/* (add any file trailer comments here) */
/* EOF autosar_swc_counter.a2l*/
