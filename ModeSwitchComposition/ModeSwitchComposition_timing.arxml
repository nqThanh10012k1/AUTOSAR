AUTOSAR XML (schema 00050)
package /Timing
  vfb timing ModeSwitchComposition_timing: component=ModeSwitchComposition
    timing-requirements:
      execution order constraint EOC: base-composition=ModeSwitchComposition
        ordered-elements:
          eoc executable entity ref SlaveSWC_MasterSWC_Run: component=SlaveSWC, executable=MasterSWC_Run, successor=SlaveSWC_MasterSWC_Step
          eoc executable entity ref SlaveSWC_MasterSWC_Step: component=SlaveSWC, executable=MasterSWC_Step, successor=MasterSWC_SlaveSWC_Step
          eoc executable entity ref MasterSWC_SlaveSWC_Step: component=MasterSWC, executable=SlaveSWC_Step
