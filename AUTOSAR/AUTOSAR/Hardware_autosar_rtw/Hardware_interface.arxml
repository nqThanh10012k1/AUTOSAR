AUTOSAR XML (schema 00050)
package /Interfaces
  sender receiver interface SRIF_Sensor_Adc
    data Adc_Value: category=VALUE, sw-calibration-access=READ-ONLY, type=UInt16
  sender receiver interface SRIF_Sensor_Tmp
    data Tmp_Value: category=VALUE, sw-calibration-access=READ-ONLY, type=Double
