AUTOSAR XML (schema 00049)
standard types defined: sint32, boolean, uint8
package /Company/Powertrain/DataTypes
  impl type UInt8_my_qualifier_const: category=VALUE, base-type=uint8, range raw 0..255, additional-native-type-qualifier=const my_qualifier
package /Company/Powertrain/DataTypes/CompuMethods
  compu method COMPU_Boolean: 0=FALSE, 1=TRUE
package /Company/Powertrain/DataTypes/DataConstrs
  range DC_SInt32: raw -2147483648..2147483647
  range DC_Boolean: raw 0..1
package /Company/Powertrain/DataTypes/Ground
  constant specification INC: value-spec=INC:1
  constant specification K: value-spec=K:2
package /Company/Powertrain/DataTypes/SwAddrMethods
  sw addr method CODE: memory-allocation-keyword-policy=ADDR-METHOD-SHORT-NAME, section-type=CODE
  sw addr method VAR: memory-allocation-keyword-policy=ADDR-METHOD-SHORT-NAME, section-type=VAR
package /Company/Powertrain/DataTypes/Units
  unit NoUnit: factor-si-to-unit=1, offset-si-to-unit=0
