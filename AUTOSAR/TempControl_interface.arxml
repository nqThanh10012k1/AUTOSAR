AUTOSAR XML (schema 00050)
package /Interfaces
  sender receiver interface Adc_Value
    data Adc_Value: category=VALUE, sw-addr-method=VAR, sw-calibration-access=READ-ONLY, type=UInt16
  sender receiver interface Tmp_Value
    data Tmp_Value: category=VALUE, sw-addr-method=VAR, sw-calibration-access=READ-ONLY, type=Double
