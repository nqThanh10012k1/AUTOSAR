AUTOSAR XML (schema 00050)
package /Timing
  swc timing MasterSWC_timing: behavior=MasterSWC_IB
