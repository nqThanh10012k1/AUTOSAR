AUTOSAR XML (schema 00050)
package /Timing
  vfb timing untitled_timing: component=untitled
    timing-requirements:
      execution order constraint EOC: base-composition=untitled
        ordered-elements:
          eoc executable entity ref E2E_Receiver_E2E_Receiver_MainFunction: component=E2E_Receiver, executable=E2E_Receiver_MainFunction, successor=E2E_Sender_E2E_Sender_MainFunction
          eoc executable entity ref E2E_Sender_E2E_Sender_MainFunction: component=E2E_Sender, executable=E2E_Sender_MainFunction
