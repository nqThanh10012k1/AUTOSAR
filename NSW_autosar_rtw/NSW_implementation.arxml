AUTOSAR XML (schema 00050)
package /Components/SwcImplementations
  swc implementation NSW_Impl: programming-language=C, sw-version=1.3.1, used-code-generator=Embedded Coder 7.10 (R2023a) 19-Nov-2022, vendor-id=0, behavior=NSW_IB
    code-descriptors:
      code Code
        artifact-descriptors:
          short-label=NSW_c, category=SWSRC
          short-label=NSW_h, category=SWHDR
          short-label=NSW_private_h, category=SWHDR
          short-label=NSW_types_h, category=SWHDR
          short-label=rtwtypes_h, category=SWHDR
    resource consumption RsrcCons_NSW
