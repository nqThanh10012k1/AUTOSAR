AUTOSAR XML (schema 00049)
standard types defined: sint32, uint8
package /Company/Powertrain/DataTypes
  impl type UInt8_my_qualifier_const: category=VALUE, base-type=uint8, range raw 0..255, additional-native-type-qualifier=const my_qualifier
package /Company/Powertrain/DataTypes/DataConstrs
  range DC_SInt32: raw -2147483648..2147483647
package /Company/Powertrain/DataTypes/Ground
  constant specification INC: value-spec=INC:1
  constant specification K: value-spec=K:2
  constant specification AMP: value-spec=AMP:2
package /Company/Powertrain/DataTypes/SwAddrMethods
  sw addr method CODE: memory-allocation-keyword-policy=ADDR-METHOD-SHORT-NAME, section-type=CODE
  sw addr method VAR: memory-allocation-keyword-policy=ADDR-METHOD-SHORT-NAME, section-type=VAR
