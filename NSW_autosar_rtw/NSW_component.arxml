AUTOSAR XML (schema 00050)
package /Components
  application sw component type NSW
    behavior NSW_IB: handle-termination-and-restart=NO-SUPPORT
      static-memorys:
        data NSW_NV_Data: category=VALUE, sw-calibration-access=READ-ONLY, type=UInt8
      ar-typed-per-instance-memorys:
        data NSW_Nv_Block: category=VALUE, sw-calibration-access=READ-ONLY, type=UInt8
      timing event Event_RE_NSW_MainFunction: start-on-event=RE_NSW_MainFunction, period=0.01
      runnable NSW_Init
      runnable RE_NSW_MainFunction
      swc service dependency SwcNv_NSW_Nv_Block: assigned-datas=role-based-data-assignment={role=ramBlock, used-data-element=NSW_Nv_Block}
        service-needs:
          nv block needs SwcNv_NSW_Nv_Block: restore-at-start=true, store-at-shutdown=true
