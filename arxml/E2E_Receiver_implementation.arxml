AUTOSAR XML (schema 00050)
package /Components/SwcImplementations
  swc implementation E2E_Receiver_Impl: programming-language=C, sw-version=1.4.1, used-code-generator=Embedded Coder 7.10 (R2023a) 19-Nov-2022, vendor-id=0, behavior=E2E_Receiver_IB
    code-descriptors:
      code Code
        artifact-descriptors:
          short-label=E2E_Receiver_c, category=SWSRC
          short-label=E2E_Receiver_h, category=SWHDR
          short-label=E2E_Receiver_private_h, category=SWHDR
          short-label=E2E_Receiver_types_h, category=SWHDR
          short-label=rtwtypes_h, category=SWHDR
    resource consumption RsrcCons_E2E_Receiver
