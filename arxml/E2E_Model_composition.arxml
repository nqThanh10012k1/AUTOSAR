AUTOSAR XML (schema 00050)
package /Components
  composition sw component type untitled
    component E2E_Sender: type=E2E_Sender
    component E2E_Receiver: type=E2E_Receiver
