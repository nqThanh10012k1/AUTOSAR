AUTOSAR XML (schema 00050)
package /Interfaces
  sender receiver interface Outport
    data Outport: category=VALUE, sw-calibration-access=READ-WRITE, type=UInt8
