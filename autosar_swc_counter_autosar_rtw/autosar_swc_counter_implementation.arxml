AUTOSAR XML (schema 00049)
package /Company/Powertrain/SwcImplementations
  swc implementation ASWC_Impl: programming-language=C, sw-version=8.5.1, used-code-generator=Embedded Coder 7.10 (R2023a) 19-Nov-2022, vendor-id=0, behavior=ASWC_IB
    code-descriptors:
      code Code
        artifact-descriptors:
          short-label=autosar_swc_counter_c, category=SWSRC
          short-label=autosar_swc_counter_data_c, category=SWSRC
          short-label=const_params_c, category=SWSRC
          short-label=look1_iu8lu64n56_binlcse_c, category=SWSRC
          short-label=SUMOUT_LOOKUP_h, category=SWHDR
          short-label=autosar_swc_counter_h, category=SWHDR
          short-label=look1_iu8lu64n56_binlcse_h, category=SWHDR
          short-label=rtwtypes_h, category=SWHDR
    resource consumption RsrcCons_autosar_swc_counter
