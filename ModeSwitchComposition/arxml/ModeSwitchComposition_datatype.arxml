AUTOSAR XML (schema 00050)
standard types defined: UInt8, uint8
package /DataTypes/DataTypeMappings
  data type mapping set MasterSWCDataTypeMappingsSet: mode-request-type-map{implementation-data-type=UInt8, mode-group=Ecu_Modes}
package /DataTypes/ModeDeclarationGroups
  mode declaration group Ecu_Modes: category=EXPLICIT_ORDER, initial-mode=INIT, on-transition-value=4  # Mode declaration group for ECU modes
    4 x mode:
      INIT: value=0
      RUN: value=1
      SLEEP: value=2
      OFF: value=3
package /DataTypes/SwAddrMethods
  sw addr method CODE: memory-allocation-keyword-policy=ADDR-METHOD-SHORT-NAME, section-type=CODE
  sw addr method CONST: section-type=CONST
  sw addr method VAR: memory-allocation-keyword-policy=ADDR-METHOD-SHORT-NAME, section-type=VAR
