AUTOSAR XML (schema 00050)
package /Timing
  vfb timing AUTOSAR_timing: component=AUTOSAR
    timing-requirements:
      execution order constraint EOC: base-composition=AUTOSAR
        ordered-elements:
          eoc executable entity ref Actuator_RE_Hardware_MainFunction: component=Actuator, executable=RE_Hardware_MainFunction, successor=Sensor_RE_Sensor_MainFunction
          eoc executable entity ref Sensor_RE_Sensor_MainFunction: component=Sensor, executable=RE_Sensor_MainFunction
