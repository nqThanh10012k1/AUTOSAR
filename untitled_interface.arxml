AUTOSAR XML (schema 00050)
package /Interfaces
  sender receiver interface RPort
    data In2: category=VALUE, sw-calibration-access=READ-ONLY, type=Double
  sender receiver interface PPort
    data Out2: category=VALUE, sw-calibration-access=READ-ONLY, type=Double
