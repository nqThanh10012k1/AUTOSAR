AUTOSAR XML (schema 00050)
package /Components/SwcImplementations
  swc implementation untitled_Impl: programming-language=C, sw-version=1.0.1, used-code-generator=Embedded Coder 7.10 (R2023a) 19-Nov-2022, vendor-id=0, behavior=untitled_IB
    code-descriptors:
      code Code
        artifact-descriptors:
          short-label=untitled_c, category=SWSRC
          short-label=rtwtypes_h, category=SWHDR
          short-label=untitled_h, category=SWHDR
          short-label=untitled_private_h, category=SWHDR
          short-label=untitled_types_h, category=SWHDR
    resource consumption RsrcCons_untitled
