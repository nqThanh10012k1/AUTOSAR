AUTOSAR XML (schema 00050)
package /Components
  composition sw component type AUTOSAR
    provide port OutBus
    component Sensor: type=Sensor
    component Actuator: type=Hardware
    connect Actuator.RP_Sensor_Adc -> Sensor.RP_Sensor_Adc
    connect Sensor.PP_Sensor_Tmp -> Actuator.PP_Sensor_Tmp
