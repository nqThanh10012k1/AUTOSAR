AUTOSAR XML (schema 00050)
package /Components/SwcImplementations
  swc implementation MasterSWC_Impl: programming-language=C, sw-version=1.6.1, used-code-generator=Embedded Coder 7.10 (R2023a) 19-Nov-2022, vendor-id=0, behavior=MasterSWC_IB
    code-descriptors:
      code Code
        artifact-descriptors:
          short-label=MasterSWC_c, category=SWSRC
          short-label=MasterSWC_data_c, category=SWSRC
          short-label=MasterSWC_h, category=SWHDR
          short-label=MasterSWC_private_h, category=SWHDR
          short-label=MasterSWC_types_h, category=SWHDR
          short-label=rtwtypes_h, category=SWHDR
    resource consumption RsrcCons_MasterSWC
