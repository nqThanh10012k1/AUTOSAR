AUTOSAR XML (schema 00049)
package /Company/Powertrain/Interfaces
  sender receiver interface InIf
    data InData: category=VALUE, sw-addr-method=VAR, sw-calibration-access=READ-ONLY, type=sint32
  sender receiver interface OutIf
    data OutData: category=VALUE, sw-addr-method=VAR, sw-calibration-access=READ-ONLY, type=sint32
