AUTOSAR XML (schema 00050)
standard types defined: UInt16, UInt8, uint16, uint8
package /DataTypes/SwAddrMethods
  sw addr method CODE: section-type=CODE
  sw addr method CONST: section-type=CONST
  sw addr method VAR: section-type=VAR
