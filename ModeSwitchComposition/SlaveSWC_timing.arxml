AUTOSAR XML (schema 00050)
package /Timing
  swc timing MasterSWC_timing: behavior=MasterSWC_IB
    timing-requirements:
      execution order constraint EOC
        ordered-elements:
          eoc executable entity ref MasterSWC_Run: executable=MasterSWC_Run, successor=MasterSWC_Step
          eoc executable entity ref MasterSWC_Step: executable=MasterSWC_Step
