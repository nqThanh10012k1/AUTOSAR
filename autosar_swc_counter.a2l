/******************************************************************************
* ASAP2 file: autosar_swc_counter.a2l
* Code generation for model "autosar_swc_counter".
* Model version : 8.5
* Simulink Coder version : 9.9 (R2023a) 19-Nov-2022
* C source code generated on : Mon Mar 31 07:40:52 2025
* Target selection: autosar.tlc
* Embedded hardware selection: Intel->x86-64 (Windows64)
* Code generation objectives: Unspecified
* Validation result: Not run
* (add additional file header information here)
******************************************************************************/ ASAP2_VERSION 1 71
/* Version 1.71 */
/begin PROJECT ProjectName "Project Comment Goes Here"
/begin HEADER "Header Comments go here" /end HEADER
/begin MODULE ModuleName "Module Comment Goes Here"
/begin MOD_PAR "MOD PAR Comment Goes Here" /end MOD_PAR
/begin MOD_COMMON "Mod Common Comment Here" BYTE_ORDER MSB_LAST ALIGNMENT_BYTE 1 ALIGNMENT_WORD 2 ALIGNMENT_LONG 4 ALIGNMENT_FLOAT32_IEEE 4 ALIGNMENT_FLOAT64_IEEE 8 ALIGNMENT_INT64 8 /end MOD_COMMON
/begin CHARACTERISTIC INC "" VALUE 0x0000 /* @ECU_Address@INC@ */ Record_UBYTE 0 autosar_swc_counter_CM_uint8 0 255 /end CHARACTERISTIC
/begin CHARACTERISTIC LIMIT "" VALUE 0x0000 /* @ECU_Address@LIMIT@ */ Record_UBYTE 0 autosar_swc_counter_CM_uint8 0 255 /end CHARACTERISTIC
/begin CHARACTERISTIC RESET "" VALUE 0x0000 /* @ECU_Address@RESET@ */ Record_UBYTE 0 autosar_swc_counter_CM_uint8 0 255 /end CHARACTERISTIC
/begin CHARACTERISTIC SUMOUT "" /* Characteristic Type */ CURVE 0x0000 /* @ECU_Address@SUMOUT@ */ SUMOUT_LOOKUP /* Maxdiff */ 0 autosar_swc_counter_CM_uint8 0 255
 /begin AXIS_DESCR /* Description of X-Axis Points */ /* Axis Type */ STD_AXIS /* Reference to Input */ NO_INPUT_QUANTITY autosar_swc_counter_CM_uint8 /* Number of Axis Pts */ 6 0 255 /end AXIS_DESCR
/end CHARACTERISTIC
/begin MEASUREMENT Lookup "" /* Data type */ UBYTE /* Conversion method */ autosar_swc_counter_CM_uint8 /* Resolution (Not used) */ 0 /* Accuracy (Not used) */ 0 /* Lower limit */ 0 /* Upper limit */ 255 ECU_ADDRESS 0x0000 /* @ECU_Address@Lookup@ */ /end MEASUREMENT
/begin MEASUREMENT autosar_swc_co_UnitDelay_DSTATE "" /* Data type */ UBYTE /* Conversion method */ autosar_swc_counter_CM_uint8 /* Resolution (Not used) */ 0 /* Accuracy (Not used) */ 0 /* Lower limit */ 0 /* Upper limit */ 255 ECU_ADDRESS 0x0000 /* @ECU_Address@autosar_swc_co_UnitDelay_DSTATE@ */ /end MEASUREMENT
/begin COMPU_METHOD /* Name of CompuMethod */ autosar_swc_counter_CM_uint8 "Q = V" /* Conversion Type */ IDENTICAL /* Format */ "%3.0" /* Units */ "" /end COMPU_METHOD
/begin RECORD_LAYOUT Record_UBYTE FNC_VALUES 1 UBYTE COLUMN_DIR DIRECT /end RECORD_LAYOUT
/* Record Layouts for Lookup Tables in Standard Axis format */
/begin RECORD_LAYOUT SUMOUT_LOOKUP AXIS_PTS_X 1 UBYTE INDEX_INCR DIRECT FNC_VALUES 2 UBYTE COLUMN_DIR DIRECT /end RECORD_LAYOUT
/begin GROUP autosar_swc_counter "autosar_swc_counter" /* Root */ ROOT /begin REF_CHARACTERISTIC INC LIMIT RESET SUMOUT /end REF_CHARACTERISTIC /begin REF_MEASUREMENT Lookup autosar_swc_co_UnitDelay_DSTATE /end REF_MEASUREMENT /end GROUP
/end MODULE
/end PROJECT
/* (add any file trailer comments here) */
/* EOF autosar_swc_counter.a2l*/
