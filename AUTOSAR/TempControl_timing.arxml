AUTOSAR XML (schema 00050)
package /Timing
  swc timing AUTOSAR_timing: behavior=untitled_IB
    timing-requirements:
      execution order constraint EOC
        ordered-elements:
          eoc executable entity ref RE_Receive_AdcValue: executable=RE_Receive_AdcValue, successor=RE_Convert_Tempertature
          eoc executable entity ref RE_Convert_Tempertature: executable=RE_Convert_Tempertature
