AUTOSAR XML (schema 00050)
package /Components
  composition sw component type ModeSwitchComposition
    component MasterSWC: type=MasterSWC
    component SlaveSWC: type=SlaveSWC
