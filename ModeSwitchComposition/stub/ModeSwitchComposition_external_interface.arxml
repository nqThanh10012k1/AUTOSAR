AUTOSAR XML (schema 00050)
package /Interfaces
  mode switch interface MSIF_Ecu_Modes: is-service=true
    mode group MG_Ecu_Modes: sw-calibration-access=READ-ONLY, type=Ecu_Modes
